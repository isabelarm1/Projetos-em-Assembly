;------------------------------------------------------------------------------
;------------------ Dupla: Isabela Rocha e Andresa Fernandes ------------------
;------------------------ SIRENE DO BOMBEIRO COM ISR --------------------------
;------------------------------------------------------------------------------
		
;------------------------------------------------------------------------------
;---------------------------- DEFINIÇÃO DAS PORTAS ----------------------------
;------------------------------------------------------------------------------
			SOM		equ	P1.6
			
;------------------------------------------------------------------------------
;------------------------- DECLARAÇÃO DAS VARÍAVEIS ---------------------------
;------------------------------------------------------------------------------
			dseg	at	8						;	Segmento de Dados
	

CONT:	ds		1
	
			bseg at 20h

FLAG:	dbit	1

			cseg	at	00h			;	Reset
				jmp		inicio				
			
			cseg	at	000bh		;	Timer 0
				jmp		timer0
			
;------------------------------------------------------------------------------
;------------------------------- INICIO ---------------------------------------
;------------------------------------------------------------------------------
inicio:
// --------- Inicializa a pilha
	mov		sp,#80h-1
	
// --------- Inicializa os timer's
	mov		TMOD,#02h		;	Timer 1: modo 0 / Timer 0: Modo 2
	mov		TH0,#(256-248)	;	Recarga timer 0 => f=600Hz / N0_1=248
	mov		TH1,#(256-97)	;	Recarga timer 1 =>0,5s => f=2Hz / N1 = 97
	setb	TR0
	setb	TR1

// --------- Inicializa a interrupção
	mov		IE,#82h			;	1000 0010(2) = 82(16)
	mov		IP,#2h
	
// --------- Zera o contador	
	mov		CONT,#0

;------------------------------------------------------------------------------
;------------------------------- VOLTA ----------------------------------------
;------------------------------------------------------------------------------

volta:
	jb		TF1,TF1_Sim			;	TF1=1?
	jmp		volta				;


TF1_Sim:
	clr		TF1
	mov		TH1,#(256-97)		;	N1 = 97
	inc		CONT
	mov		a,CONT
	cjne	a,#48,encontro1		;	CONT<=79?   / M1 = 48
	mov		CONT,#0
	jb		FLAG,Flag_Sim		;	FLAG=1?
	mov		TH0, #(256-207)		;	f2=720Hz / N0_2 = 207
	cpl		FLAG
	jmp		encontro1
	
Flag_Sim:
	mov		TH0, #(256-248)		; 	f1=600Hz / N0_1 = 248
	cpl		FLAG

encontro1:
	jmp		volta

;------------------------------------------------------------------------------
;------------------------------- Timer 0 --------------------------------------
;------------------------------------------------------------------------------

timer0:
	cpl		SOM
	RETI

end